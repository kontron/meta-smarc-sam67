## conf/layer.conf
```bitbake
# We have a conf and classes directory, add to BBPATH
BBPATH .= ":${LAYERDIR}"

# We have recipes-* directories, add to BBFILES
BBFILES += "${LAYERDIR}/recipes-*/*/*.bb \
            ${LAYERDIR}/recipes-*/*/*.bbappend"

BBFILE_COLLECTIONS += "meta-kex"
BBFILE_PATTERN_meta-kex = "^${LAYERDIR}/"
BBFILE_PRIORITY_meta-kex = "5"

LAYERDEPENDS_meta-kex = " \
    core \
    meta-arm \
"

LAYERSERIES_COMPAT_meta-kex = "scarthgap"

LICENSE_PATH += "${LAYERDIR}/licenses"

SIGGEN_EXCLUDERECIPES_ABISAFE += " \
    mesa-pvr \
"

HOSTTOOLS_NONFATAL += "truncate xxd comm"

TI_COMMON_DEPLOY ?= "${TOPDIR}/deploy-ti"
DEPLOY_DIR_IMAGE:ti-soc = "${TI_COMMON_DEPLOY}/images/${MACHINE}"
SDK_DEPLOY:ti-soc = "${TI_COMMON_DEPLOY}/sdk"
PSEUDO_IGNORE_PATHS:append:ti-soc = ",${TI_COMMON_DEPLOY}"
```

## conf/machine/sa67-k3r5.conf
```bitbake
#@TYPE: Machine
#@NAME: J722S EVM (R5F)
#@DESCRIPTION: Machine configuration for the TI J722S EVM (R5F core)

require conf/machine/include/k3r5.inc

SYSFW_SOC = "j722s"
SYSFW_CONFIG = "evm"
SYSFW_SUFFIX = "hs-fs"

UBOOT_MACHINE = "kontron_sa67_r5_defconfig"
```

## conf/machine/sa67-mainline.conf
```bitbake
#@TYPE: Machine
#@NAME: SMARC SA67
#@DESCRIPTION: Machine configuration for the Kontron Smarc SA67 board

require conf/machine/include/j722s-sa67.inc

TI_PREFERRED_BSP ?= "upstream"

# ==========
# upstream
# current upstream kernel and u-boot
# ==========
BSP_KERNEL_PROVIDER:bsp-upstream = "linux-ti-mainline"
BSP_KERNEL_VERSION:bsp-upstream = "%"
BSP_BOOTLOADER_PROVIDER:bsp-upstream = "u-boot-ti-mainline"
BSP_BOOTLOADER_VERSION:bsp-upstream = "%"

BSP_SGX_DRIVER_PROVIDER:bsp-upstream = "ti-sgx-ddk-km"
BSP_SGX_DRIVER_VERSION:bsp-upstream = "1.17%"
BSP_SGX_UMLIBS_VERSION:bsp-upstream = "1.17%"
BSP_ROGUE_DRIVER_PROVIDER:bsp-upstream = "ti-img-rogue-driver"
BSP_ROGUE_DRIVER_VERSION:bsp-upstream = "25%"
BSP_ROGUE_UMLIBS_VERSION:bsp-upstream = "25%"
BSP_MESA_PVR_VERSION:bsp-upstream = "24%"

# GPU support requires out-of-tree SGX and Rogue drivers not available
# in mainline, usually present in TI staging or derivative like BB.org
# MACHINE_FEATURES:remove:bsp-upstream = "gpu"

# GC320 support requires out-of-tree drivers not available in mainline
MACHINE_FEATURES:remove:bsp-upstream = "gc320"

KERNEL_DEVICETREE_PREFIX = ""

KERNEL_DEVICETREE += "ti/k3-am67a-kontron-sa67.dtb \
                      ti/k3-am67a-kontron-sa67-dp0.dtbo \
                      ti/k3-am67a-kontron-sa67-gbe1.dtbo \
                      ti/k3-am67a-kontron-sa67-rtc-rv8263.dtbo \
                      ti/k3-am67a-kontron-sa67-gpios.dtbo \
                      ti/k3-am67a-kontron-sa67-lvds0-evervision-vgg644804.dtbo \
                      ti/k3-am67a-kontron-sa67-lvds-auo-p238han01.dtbo \
	              ti/k3-am67a-kontron-sa67-ads2.dtbo \
                      ti/k3-am67a-kontron-sa67-ads2-rev-a-fixups.dtbo"

UBOOT_MACHINE = "kontron_sa67_a53_defconfig"

# Configure extlinux

UBOOT_EXTLINUX = "1"

DEVICETREE_FILE = "${@(d.getVar('KERNEL_DEVICETREE') or "").replace("ti/","")}"

IMAGE_BOOT_FILES += " \
	${DEVICETREE_FILE} \
	${KERNEL_IMAGETYPE} \
	extlinux.conf;extlinux/extlinux.conf \
	"

PREFERRED_VERSION_linux-firmware = "20250708"

WKS_FILE = "sa67.wks"

# Allow overriding values using optional *-extra.conf
include conf/machine/${MACHINE}-extra.conf
```

## conf/machine/sa67.conf
```bitbake
#@TYPE: Machine
#@NAME: SMARC SA67
#@DESCRIPTION: Machine configuration for the Kontron Smarc SA67 board

require conf/machine/include/j722s-sa67.inc

KERNEL_DEVICETREE_PREFIX = ""

KERNEL_DEVICETREE += "ti/k3-am67a-kontron-sa67.dtb"

UBOOT_MACHINE = "kontron_sa67_a53_defconfig"
```
